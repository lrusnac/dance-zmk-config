## boards/shields/morepork/Kconfig.shield
```kconfig
# Copyright (c) 2020 Pete Johanson
# SPDX-License-Identifier: MIT

config SHIELD_MOREPORK_LEFT
    def_bool $(shields_list_contains,morepork_left)

config SHIELD_MOREPORK_RIGHT
    def_bool $(shields_list_contains,morepork_right)
```
